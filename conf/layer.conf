## conf/layer.conf
```bitbake
# We have a conf and classes directory, add to BBPATH
BBPATH .= ":${LAYERDIR}"

# We have recipes-* directories, add to BBFILES
BBFILES += "${LAYERDIR}/recipes-*/*/*.bb \
	${LAYERDIR}/recipes-*/*/*.bbappend"

BBFILE_COLLECTIONS += "edyev"
BBFILE_PATTERN_edyev = "^${LAYERDIR}/"
BBFILE_PRIORITY_example = "5"


KERNEL_DEVICETREE_append += " freescale/markem-imx8m.dtb"
```
